/*
 *   Copyright (C) 2009-2017,2020 by Jonathan Naylor G4KLX
 *   Copyright (C) 2017 by Andy Uribe CA6JAU
 *
 *   This program is free software; you can redistribute it and/or modify
 *   it under the terms of the GNU General Public License as published by
 *   the Free Software Foundation; either version 2 of the License, or
 *   (at your option) any later version.
 *
 *   This program is distributed in the hope that it will be useful,
 *   but WITHOUT ANY WARRANTY; without even the implied warranty of
 *   MERCHANTABILITY or FITNESS FOR A PARTICULAR PURPOSE.  See the
 *   GNU General Public License for more details.
 *
 *   You should have received a copy of the GNU General Public License
 *   along with this program; if not, write to the Free Software
 *   Foundation, Inc., 675 Mass Ave, Cambridge, MA 02139, USA.
 *
 *   Modified by KD0OSS for use on Module17/OpenRTX
 */

#include <DSTAR/DStar.h>
#include <DSTAR/DStar_IO.hpp>
#include <DSTAR/RingBuffer.h>
#include <drivers/USART3_MOD17.h>
#include <interfaces/platform.h>
#include <DSTAR/DStarTX.h>

#include <DSTAR/DStarDefines.h>

const uint8_t BIT_SYNC = 0xAAU;

const uint8_t FRAME_SYNC[] = {0xEAU, 0xA6U, 0x00U};

// Generated using gaussfir(0.35, 1, 5) in MATLAB
static q15_t GAUSSIAN_0_35_FILTER[] = {0, 0, 0, 0, 1001, 3514, 9333, 18751, 28499, 32767, 28499, 18751, 9333, 3514, 1001}; // numTaps = 15, L = 5
const uint16_t GAUSSIAN_0_35_FILTER_PHASE_LEN = 3U; // phaseLength = numTaps/L

const q15_t DSTAR_LEVEL0 = -841;
const q15_t DSTAR_LEVEL1 =  841;

const uint8_t BIT_MASK_TABLE[] = {0x80U, 0x40U, 0x20U, 0x10U, 0x08U, 0x04U, 0x02U, 0x01U};

const uint8_t INTERLEAVE_TABLE_TX[] = {
  0x00U, 0x04U, 0x04U, 0x00U, 0x07U, 0x04U, 0x0BU, 0x00U, 0x0EU, 0x04U,
  0x12U, 0x00U, 0x15U, 0x04U, 0x19U, 0x00U, 0x1CU, 0x04U, 0x20U, 0x00U,
  0x23U, 0x04U, 0x27U, 0x00U, 0x2AU, 0x04U, 0x2DU, 0x07U, 0x31U, 0x02U,
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  0x1CU, 0x03U, 0x1FU, 0x07U, 0x23U, 0x03U, 0x26U, 0x07U, 0x2AU, 0x03U
};

const uint8_t SCRAMBLE_TABLE_TX[] = {
  0x00U, 0xF7U, 0x34U, 0x09U, 0x44U, 0x46U, 0xD7U, 0x06U, 0xB3U, 0x72U,
  0xDEU, 0x42U, 0xF5U, 0xA5U, 0xD8U, 0xF1U, 0x87U, 0x7BU, 0x9AU, 0x04U,
  0x22U, 0xA3U, 0x6BU, 0x83U, 0x59U, 0x39U, 0x6FU, 0xA1U, 0xFAU, 0x52U,
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  0xB8U, 0xA7U, 0x49U, 0x20U, 0x32U, 0xBAU, 0x36U, 0x98U, 0x95U, 0xF3U,
  0x06U};

const uint8_t DSTAR_HEADER = 0x00U;
const uint8_t DSTAR_DATA   = 0x01U;
const uint8_t DSTAR_EOT    = 0x02U;

const uint16_t DC_OFFSET = 2048;

extern CRingBuffer<uint16_t> m_txBuffer;

CDStarTX::CDStarTX() :
m_buffer(),
m_modFilter(),
m_modState(),
m_poBuffer(),
m_poLen(0U),
m_poPtr(0U),
m_txDelay(100U)       // 100ms
{
  ::memset(m_modState, 0x00U, 20U * sizeof(q15_t));

  m_modFilter.L           = DSTAR_RADIO_SYMBOL_LENGTH;
  m_modFilter.phaseLength = GAUSSIAN_0_35_FILTER_PHASE_LEN;
  m_modFilter.pCoeffs     = GAUSSIAN_0_35_FILTER;
  m_modFilter.pState      = m_modState;
}

void CDStarTX::process()
{
  if (m_buffer.getData() == 0U && m_poLen == 0U)
    return;

  uint8_t type = m_buffer.peek();

  if (type == DSTAR_HEADER && m_poLen == 0U) {
    if (!m_tx) {
      for (uint16_t i = 0U; i < m_txDelay; i++)
        m_poBuffer[m_poLen++] = BIT_SYNC;
    } else {
      // Pop the type byte off
      uint8_t dummy;
      m_buffer.get(dummy);

      uint8_t header[DSTAR_HEADER_LENGTH_BYTES];
      for (uint8_t i = 0U; i < DSTAR_HEADER_LENGTH_BYTES; i++)
        m_buffer.get(header[i]);

      uint8_t buffer[86U];
      txHeader(header, buffer + 2U);

      buffer[0U]  = FRAME_SYNC[0U];
      buffer[1U]  = FRAME_SYNC[1U];
      buffer[2U] |= FRAME_SYNC[2U];
      
      for (uint8_t i = 0U; i < 85U; i++)
        m_poBuffer[m_poLen++] = buffer[i];
    }

    m_poPtr = 0U;
  }
 
  if (type == DSTAR_DATA && m_poLen == 0U) {
    // Pop the type byte off
    uint8_t dummy;
    m_buffer.get(dummy);

    for (uint8_t i = 0U; i < DSTAR_DATA_LENGTH_BYTES; i++)
      m_buffer.get(m_poBuffer[m_poLen++]);

    m_poPtr = 0U;
  }

  if (type == DSTAR_EOT && m_poLen == 0U) {
    // Pop the type byte off
    uint8_t dummy;
    m_buffer.get(dummy);

    for (uint8_t j = 0U; j < 3U; j++) {
      for (uint8_t i = 0U; i < DSTAR_END_SYNC_LENGTH_BYTES; i++)
        m_poBuffer[m_poLen++] = DSTAR_END_SYNC_BYTES[i];
    }
     
    m_poPtr = 0U;
  }

  if (m_poLen > 0U) {
    uint16_t space = m_txBuffer.getSpace();
    
    while (space > (8U * DSTAR_RADIO_SYMBOL_LENGTH)) {
      uint8_t c = m_poBuffer[m_poPtr++];
      writeByte(c);

      space -= 8U * DSTAR_RADIO_SYMBOL_LENGTH;
      
      if (m_poPtr >= m_poLen) {
        m_poPtr = 0U;
        m_poLen = 0U;
        return;
      }
    }
  }
}

uint8_t CDStarTX::writeHeader(const uint8_t* header, uint16_t length)
{
  if (length != DSTAR_HEADER_LENGTH_BYTES)
    return 4U;

  uint16_t space = m_buffer.getSpace();
  if (space < (DSTAR_HEADER_LENGTH_BYTES + 1U)) {
 //   DEBUG2("DStarTX: header space available", space);
    return 5U;
  }

  m_buffer.put(DSTAR_HEADER);

  for (uint8_t i = 0U; i < DSTAR_HEADER_LENGTH_BYTES; i++)
    m_buffer.put(header[i]);
    
  return 0U;
}

uint8_t CDStarTX::writeData(const uint8_t* data, uint16_t length)
{
  if (length != DSTAR_DATA_LENGTH_BYTES)
    return 4U;

  uint16_t space = m_buffer.getSpace();
  if (space < (DSTAR_DATA_LENGTH_BYTES + 1U)) {
 //   DEBUG2("DStarTX: data space available", space);
    return 5U;
  }

  m_buffer.put(DSTAR_DATA);

  for (uint8_t i = 0U; i < DSTAR_DATA_LENGTH_BYTES; i++)
    m_buffer.put(data[i]);
    
  return 0U;
}

uint8_t CDStarTX::writeEOT()
{
  uint16_t space = m_buffer.getSpace();
  if (space < 1U) {
 //   DEBUG2("DStarTX: EOT space available", space);
    return 5U;
  }

  m_buffer.put(DSTAR_EOT);

  return 0U;
}

void CDStarTX::txHeader(const uint8_t* in, uint8_t* out) const
{
  uint8_t intermediate[84U];
  uint32_t i;

  for (i = 0U; i < 83U; i++) {
    intermediate[i] = 0x00U;
    out[i] = 0x00U;
  }

  // Convolve the header
  uint8_t d, d1 = 0U, d2 = 0U, g0, g1;
  uint32_t k = 0U;
  for (i = 0U; i < 42U; i++) {
    for (uint8_t j = 0U; j < 8U; j++) {
      uint8_t mask = (0x01U << j);
      d = 0U;

      if (in[i] & mask)
        d = 1U;

      g0 = (d + d2) & 1;
      g1 = (d + d1 + d2) & 1;
      d2 = d1;
      d1 = d;

      if (g1)
        intermediate[k >> 3] |= BIT_MASK_TABLE[k & 7];
      k++;

      if (g0)
        intermediate[k >> 3] |= BIT_MASK_TABLE[k & 7];
      k++;
    }
  }

  // Interleave the header
  i = 0U;
  while (i < 660U) {
    unsigned char d = intermediate[i >> 3];

    if (d & 0x80U)
      out[INTERLEAVE_TABLE_TX[i * 2U]] |= (0x01U << INTERLEAVE_TABLE_TX[i * 2U + 1U]);
    i++;

    if (d & 0x40U)
      out[INTERLEAVE_TABLE_TX[i * 2U]] |= (0x01U << INTERLEAVE_TABLE_TX[i * 2U + 1U]);
    i++;

    if (d & 0x20U)
      out[INTERLEAVE_TABLE_TX[i * 2U]] |= (0x01U << INTERLEAVE_TABLE_TX[i * 2U + 1U]);
    i++;

    if (d & 0x10U)
      out[INTERLEAVE_TABLE_TX[i * 2U]] |= (0x01U << INTERLEAVE_TABLE_TX[i * 2U + 1U]);
    i++;

    if (i < 660U) {
      if (d & 0x08U)
        out[INTERLEAVE_TABLE_TX[i * 2U]] |= (0x01U << INTERLEAVE_TABLE_TX[i * 2U + 1U]);
      i++;

      if (d & 0x04U)
        out[INTERLEAVE_TABLE_TX[i * 2U]] |= (0x01U << INTERLEAVE_TABLE_TX[i * 2U + 1U]);
      i++;

      if (d & 0x02U)
        out[INTERLEAVE_TABLE_TX[i * 2U]] |= (0x01U << INTERLEAVE_TABLE_TX[i * 2U + 1U]);
      i++;

      if (d & 0x01U)
        out[INTERLEAVE_TABLE_TX[i * 2U]] |= (0x01U << INTERLEAVE_TABLE_TX[i * 2U + 1U]);
      i++;
    }
  }

  // Scramble the header
  for (i = 0U; i < 83U; i++)
    out[i] ^= SCRAMBLE_TABLE_TX[i];
}

void CDStarTX::writeByte(uint8_t c)
{
  q15_t inBuffer[8U];
  q15_t outBuffer[DSTAR_RADIO_SYMBOL_LENGTH * 8U];

  uint8_t mask = 0x01U;

  for (uint8_t i = 0U; i < 8U; i++) {
    if ((c & mask) == mask)
      inBuffer[i] = DSTAR_LEVEL0;
    else
      inBuffer[i] = DSTAR_LEVEL1;

    mask <<= 1;
  }

  ::arm_fir_interpolate_q15(&m_modFilter, inBuffer, outBuffer, 8U);
  
  // Switch the transmitter on if needed
  if (!m_tx) {
    m_tx = true;
 //   platform_PTT(pttInvert ? false : true);
    usleep(5000);
  }

  for (uint16_t i = 0U; i < 40; i++) {
    q31_t res1 = outBuffer[i] * (m_txLevel * 128);
    q15_t res2 = q15_t(__SSAT((res1 >> 15), 16));
    uint16_t res3 = uint16_t((res2 * 14) + DC_OFFSET);

    m_txBuffer.put(res3);
  }
}

void CDStarTX::setTXDelay(uint8_t delay)
{
  m_txDelay = 300U + uint16_t(delay) * 6U;        // 250ms + tx delay

  if (m_txDelay > 600U)
    m_txDelay = 600U;
}

void CDStarTX::setTXLevel(uint8_t level)
{
	m_txLevel = level;
}

uint8_t CDStarTX::getSpace() const
{
  return m_buffer.getSpace() / (DSTAR_DATA_LENGTH_BYTES + 1U);
}

