/*
 *   Copyright (C) 2009-2016 by Jonathan Naylor G4KLX
 *
 *   This program is free software; you can redistribute it and/or modify
 *   it under the terms of the GNU General Public License as published by
 *   the Free Software Foundation; either version 2 of the License, or
 *   (at your option) any later version.
 *
 *   This program is distributed in the hope that it will be useful,
 *   but WITHOUT ANY WARRANTY; without even the implied warranty of
 *   MERCHANTABILITY or FITNESS FOR A PARTICULAR PURPOSE.  See the
 *   GNU General Public License for more details.
 *
 *   You should have received a copy of the GNU General Public License
 *   along with this program; if not, write to the Free Software
 *   Foundation, Inc., 675 Mass Ave, Cambridge, MA 02139, USA.
 *
 *   (2025) Modified by KD0OSS for use in Module17/OpenRTX
 */

#include <DSTAR/DStar.h>
#include <DSTAR/DStarRX.h>
#include <cstdint>
#include <DSTAR/DStarDefines.h>
#include <DSTAR/Utils.h>
#include <DSTAR/RingBuffer.h>
//#include <drivers/USART3_MOD17.h>

extern CRingBuffer<uint8_t> ambeBuffer;

const unsigned int BUFFER_LENGTH = 200U;

const uint8_t MMDVM_FRAME_START  = 0xE0U;
const uint8_t MMDVM_DSTAR_HEADER = 0x10U;
const uint8_t MMDVM_DSTAR_DATA   = 0x11U;
const uint8_t MMDVM_DSTAR_EOT    = 0x13U;
const uint8_t MMDVM_DSTAR_LOST   = 0x12U;

const uint32_t PLLMAX = 0x10000U;
const uint32_t PLLINC = PLLMAX / DSTAR_RADIO_BIT_LENGTH;
const uint32_t INC    = PLLINC / 32U;

const unsigned int MAX_SYNC_BITS = 50U * DSTAR_DATA_LENGTH_BITS;

const unsigned int SYNC_POS        = 21U * DSTAR_DATA_LENGTH_BITS;
const unsigned int SYNC_SCAN_START = SYNC_POS - 3U;
const unsigned int SYNC_SCAN_END   = SYNC_POS + 3U;

const q15_t THRESHOLD = 0;

// D-Star bit order version of 0x55 0x55 0x6E 0x0A
const uint32_t FRAME_SYNC_DATA = 0x00557650U;
const uint32_t FRAME_SYNC_MASK = 0x00FFFFFFU;
const uint8_t  FRAME_SYNC_ERRS = 2U;

// D-Star bit order version of 0x55 0x2D 0x16
const uint32_t DATA_SYNC_DATA = 0x00AAB468U;
const uint32_t DATA_SYNC_MASK = 0x00FFFFFFU;
const uint8_t  DATA_SYNC_ERRS = 2U;

// D-Star bit order version of 0x55 0x55 0xC8 0x7A
const uint32_t END_SYNC_DATA = 0xAAAA135EU;
const uint32_t END_SYNC_MASK = 0xFFFFFFFFU;
const uint8_t  END_SYNC_ERRS = 3U;

const uint8_t BIT_MASK_TABLE0[] = {0x7FU, 0xBFU, 0xDFU, 0xEFU, 0xF7U, 0xFBU, 0xFDU, 0xFEU};
const uint8_t BIT_MASK_TABLE1[] = {0x80U, 0x40U, 0x20U, 0x10U, 0x08U, 0x04U, 0x02U, 0x01U};
const uint8_t BIT_MASK_TABLE2[] = {0xFEU, 0xFDU, 0xFBU, 0xF7U, 0xEFU, 0xDFU, 0xBFU, 0x7FU};
const uint8_t BIT_MASK_TABLE3[] = {0x01U, 0x02U, 0x04U, 0x08U, 0x10U, 0x20U, 0x40U, 0x80U};

#define WRITE_BIT1(p,i,b) p[(i)>>3] = (b) ? (p[(i)>>3] | BIT_MASK_TABLE1[(i)&7]) : (p[(i)>>3] & BIT_MASK_TABLE0[(i)&7])
#define READ_BIT1(p,i)    (p[(i)>>3] & BIT_MASK_TABLE1[(i)&7])

#define WRITE_BIT2(p,i,b) p[(i)>>3] = (b) ? (p[(i)>>3] | BIT_MASK_TABLE3[(i)&7]) : (p[(i)>>3] & BIT_MASK_TABLE2[(i)&7])
#define READ_BIT2(p,i)    (p[(i)>>3] & BIT_MASK_TABLE3[(i)&7])

const uint8_t INTERLEAVE_TABLE_RX[] = {
  0x00U, 0x00U, 0x03U, 0x00U, 0x06U, 0x00U, 0x09U, 0x00U, 0x0CU, 0x00U,
  0x0FU, 0x00U, 0x12U, 0x00U, 0x15U, 0x00U, 0x18U, 0x00U, 0x1BU, 0x00U,
  0x1EU, 0x00U, 0x21U, 0x00U, 0x24U, 0x00U, 0x27U, 0x00U, 0x2AU, 0x00U,
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  0x44U, 0x07U, 0x47U, 0x07U, 0x4AU, 0x07U, 0x4DU, 0x07U, 0x50U, 0x07U,
};

const uint8_t SCRAMBLE_TABLE_RX[] = {
  0x70U, 0x4FU, 0x93U, 0x40U, 0x64U, 0x74U, 0x6DU, 0x30U, 0x2BU, 0xE7U,
  0x2DU, 0x54U, 0x5FU, 0x8AU, 0x1DU, 0x7FU, 0xB8U, 0xA7U, 0x49U, 0x20U,
  0x32U, 0xBAU, 0x36U, 0x98U, 0x95U, 0xF3U, 0x16U, 0xAAU, 0x2FU, 0xC5U,
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  0x7BU, 0x9AU, 0x04U, 0x22U, 0xA3U, 0x6BU, 0x83U, 0x59U, 0x39U, 0x6FU,
  0x00U};

const uint16_t CCITT_TABLE[] = {
  0x0000U, 0x1189U, 0x2312U, 0x329bU, 0x4624U, 0x57adU, 0x6536U, 0x74bfU,
  0x8c48U, 0x9dc1U, 0xaf5aU, 0xbed3U, 0xca6cU, 0xdbe5U, 0xe97eU, 0xf8f7U,
  0x1081U, 0x0108U, 0x3393U, 0x221aU, 0x56a5U, 0x472cU, 0x75b7U, 0x643eU,
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  0x7bc7U, 0x6a4eU, 0x58d5U, 0x495cU, 0x3de3U, 0x2c6aU, 0x1ef1U, 0x0f78U};

CDStarRX::CDStarRX() :
m_pll(0U),
m_prev(false),
m_rxState(DSRXS_NONE),
m_patternBuffer(0x00U),
m_rxBuffer(),
m_rxBufferBits(0U),
m_dataBits(0U),
m_mar(0U),
m_pathMetric(),
m_pathMemory0(),
m_pathMemory1(),
m_pathMemory2(),
m_pathMemory3(),
m_fecOutput(),
m_samples(),
m_samplesPtr(0U)
{
	memset(m_myCall, 0, 9);
	memset(m_urCall, 0, 9);
	memset(m_rpt1Call, 0, 9);
	memset(m_rpt2Call, 0, 9);
	memset(m_suffix, 0, 5);
	memset(m_text, 0, 21);
}

void CDStarRX::reset()
{
  m_pll           = 0U;
  m_prev          = false;
  m_rxState       = DSRXS_NONE;
  m_patternBuffer = 0x00U;
  m_rxBufferBits  = 0U;
  m_dataBits      = 0U;
  m_samplesPtr    = 0U;
  m_synced        = false;
}

void CDStarRX::samples(const q15_t* samples, uint8_t length)
{
  for (uint16_t i = 0U; i < length; i++) {
    m_samples[m_samplesPtr] = samples[i];

    bool bit = samples[i] < THRESHOLD;

    if (bit != m_prev) {
      if (m_pll < (PLLMAX / 2U))
        m_pll += INC;
      else
        m_pll -= INC;
    }

    m_prev = bit;

    m_pll += PLLINC;

    if (m_pll >= PLLMAX) {
      m_pll -= PLLMAX;

      switch (m_rxState) {
        case DSRXS_NONE:
          processNone(bit);
          break;
        case DSRXS_HEADER:
          processHeader(bit);
          break;
        case DSRXS_DATA:
          processData(bit);
          break;
        default:
          break;
      }
    }

    m_samplesPtr++;
    if (m_samplesPtr >= DSTAR_DATA_SYNC_LENGTH_BITS)
      m_samplesPtr = 0U;
  }
}

void CDStarRX::processNone(bool bit)
{
  m_patternBuffer <<= 1;
  if (bit)
    m_patternBuffer |= 0x01U;

  // Fuzzy matching of the frame sync sequence
  if (countBits32((m_patternBuffer & FRAME_SYNC_MASK) ^ FRAME_SYNC_DATA) <= FRAME_SYNC_ERRS) {

    ::memset(m_rxBuffer, 0x00U, DSTAR_FEC_SECTION_LENGTH_BYTES);
    m_rxBufferBits = 0U;

    m_rxState = DSRXS_HEADER;
    return;
  }

  // Exact matching of the data sync bit sequence
  if (countBits32((m_patternBuffer & DATA_SYNC_MASK) ^ DATA_SYNC_DATA) == 0U) {
    m_synced = true;

    for (int i=0;i<9;i++)
      ambeBuffer.put(DSTAR_DATA_SYNC_BYTES[i]);

    slowSpeedDataDecode(m_message[9U], m_message[10U], m_message[11U]);

    ::memset(m_rxBuffer, 0x00U, DSTAR_DATA_LENGTH_BYTES + 2U);
    m_rxBufferBits = 0U;

    m_dataBits  = 0U;
    m_rxState   = DSRXS_DATA;
    return;
  }
}

void CDStarRX::processHeader(bool bit)
{
  m_patternBuffer <<= 1;
  if (bit)
    m_patternBuffer |= 0x01U;

  WRITE_BIT2(m_rxBuffer, m_rxBufferBits, bit);
  m_rxBufferBits++;

  // A full FEC header
  if (m_rxBufferBits == DSTAR_FEC_SECTION_LENGTH_BITS) {
    // Process the scrambling, interleaving and FEC, then return if the checksum was correct
    unsigned char header[DSTAR_HEADER_LENGTH_BYTES];
    bool ok = rxHeader(m_rxBuffer, header);
    if (ok) {
      ::memset(m_rpt1Call, 0x00U, 9);
      ::memset(m_rpt2Call, 0x00U, 9);
      ::memset(m_urCall, 0x00U, 9);
      ::memset(m_myCall, 0x00U, 9);
      ::memset(m_suffix, 0x00U, 5);

	  int field = 0;
      int col = 0;
      for (int i=3;i<39;i++)
      {
        if (field == 0)
          m_rpt1Call[col++] = header[i];
        if (field == 1)
          m_rpt2Call[col++] = header[i];
        if (field == 2)
          m_urCall[col++] = header[i];
        if (field == 3)
          m_myCall[col++] = header[i];
        if (field == 4)
          m_suffix[col++] = header[i];
        if (col == 8)
        {
          field++;
          col = 0;
        }
      }
      ::memset(m_rxBuffer, 0x00U, DSTAR_DATA_LENGTH_BYTES + 2U);
      m_rxBufferBits = 0U;

      m_rxState   = DSRXS_DATA;
      m_dataBits  = SYNC_POS - DSTAR_DATA_LENGTH_BITS + 1U;
    } else {
      // The checksum failed, return to looking for sync
      m_rxState = DSRXS_NONE;
    }
  }
}

void CDStarRX::processData(bool bit)
{
  m_patternBuffer <<= 1;
  if (bit)
    m_patternBuffer |= 0x01U;

  WRITE_BIT2(m_rxBuffer, m_rxBufferBits, bit);
  m_rxBufferBits++;

  // Fuzzy matching of the end frame sequences
  if (countBits32((m_patternBuffer & END_SYNC_MASK) ^ END_SYNC_DATA) <= END_SYNC_ERRS) {
    m_synced = false;

    m_rxState = DSRXS_NONE;
    return;
  }

  // Fuzzy matching of the data sync bit sequence
  bool syncSeen = false;
  if (m_dataBits >= SYNC_SCAN_START && m_dataBits <= (SYNC_POS + 1U)) {
    if (countBits32((m_patternBuffer & DATA_SYNC_MASK) ^ DATA_SYNC_DATA) <= DATA_SYNC_ERRS) {
      m_rxBufferBits = DSTAR_DATA_LENGTH_BITS;
      m_dataBits = 0U;
      syncSeen   = true;
    }
  }

  // Check to see if the sync is arriving late
  if (m_dataBits == SYNC_POS) {
    for (uint8_t i = 1U; i <= 3U; i++) {
      uint32_t syncMask = DATA_SYNC_MASK >> i;
      uint32_t syncData = DATA_SYNC_DATA >> i;
      if (countBits32((m_patternBuffer & syncMask) ^ syncData) <= DATA_SYNC_ERRS) {
        m_rxBufferBits -= i;
        m_dataBits     -= i;
        break;
      }
    }
  }

  m_dataBits++;

  // We've not seen a data sync for too long, signal RXLOST and change to RX_NONE
  if (m_dataBits >= MAX_SYNC_BITS) {
    m_synced = false;
    m_rxState = DSRXS_NONE;
    return;
  }

  // Send a data frame to the host if the required number of bits have been received, or if a data sync has been seen
  if (m_rxBufferBits == DSTAR_DATA_LENGTH_BITS) {
    if (syncSeen) {
      m_rxBuffer[9U]  = DSTAR_DATA_SYNC_BYTES[9U];
      m_rxBuffer[10U] = DSTAR_DATA_SYNC_BYTES[10U];
      m_rxBuffer[11U] = DSTAR_DATA_SYNC_BYTES[11U];
      m_synced = true;
    }

    slowSpeedDataDecode(m_rxBuffer[9U], m_rxBuffer[10U], m_rxBuffer[11U]);

    // Save voice data into ring buffer
    for (int i=0;i<9;i++)
      ambeBuffer.put(m_rxBuffer[i]);

    // Start the next frame
    ::memset(m_rxBuffer, 0x00U, DSTAR_DATA_LENGTH_BYTES + 2U);
    m_rxBufferBits = 0U;
  }
}

bool CDStarRX::rxHeader(uint8_t* in, uint8_t* out)
{
  int i;

  // Descramble the header
  for (i = 0; i < int(DSTAR_FEC_SECTION_LENGTH_BYTES); i++)
    in[i] ^= SCRAMBLE_TABLE_RX[i];

  unsigned char intermediate[84U];
  for (i = 0; i < 84; i++)
    intermediate[i] = 0x00U;

  // Deinterleave the header
  i = 0;
  while (i < 660) {
    unsigned char d = in[i / 8];

    if (d & 0x01U)
      intermediate[INTERLEAVE_TABLE_RX[i * 2U]] |= (0x80U >> INTERLEAVE_TABLE_RX[i * 2U + 1U]);
    i++;

    if (d & 0x02U)
      intermediate[INTERLEAVE_TABLE_RX[i * 2U]] |= (0x80U >> INTERLEAVE_TABLE_RX[i * 2U + 1U]);
    i++;

    if (d & 0x04U)
      intermediate[INTERLEAVE_TABLE_RX[i * 2U]] |= (0x80U >> INTERLEAVE_TABLE_RX[i * 2U + 1U]);
    i++;

    if (d & 0x08U)
      intermediate[INTERLEAVE_TABLE_RX[i * 2U]] |= (0x80U >> INTERLEAVE_TABLE_RX[i * 2U + 1U]);
    i++;

    if (i < 660) {
      if (d & 0x10U)
        intermediate[INTERLEAVE_TABLE_RX[i * 2U]] |= (0x80U >> INTERLEAVE_TABLE_RX[i * 2U + 1U]);
      i++;

      if (d & 0x20U)
        intermediate[INTERLEAVE_TABLE_RX[i * 2U]] |= (0x80U >> INTERLEAVE_TABLE_RX[i * 2U + 1U]);
      i++;

      if (d & 0x40U)
        intermediate[INTERLEAVE_TABLE_RX[i * 2U]] |= (0x80U >> INTERLEAVE_TABLE_RX[i * 2U + 1U]);
      i++;

      if (d & 0x80U)
        intermediate[INTERLEAVE_TABLE_RX[i * 2U]] |= (0x80U >> INTERLEAVE_TABLE_RX[i * 2U + 1U]);
      i++;
    }
  }

  for (i = 0; i < 4; i++)
    m_pathMetric[i] = 0;

  int decodeData[2U];

  m_mar = 0U;
  for (i = 0; i < 660; i += 2) {
    if (intermediate[i >> 3] & (0x80U >> (i & 7)))
      decodeData[1U] = 1U;
    else
      decodeData[1U] = 0U;

    if (intermediate[i >> 3] & (0x40U >> (i & 7)))
      decodeData[0U] = 1U;
    else
      decodeData[0U] = 0U;

    viterbiDecode(decodeData);
  }

  traceBack();

  for (i = 0; i < int(DSTAR_HEADER_LENGTH_BYTES); i++)
    out[i] = 0x00U;

  unsigned int j = 0;
  for (i = 329; i >= 0; i--) {
    if (READ_BIT1(m_fecOutput, i))
      out[j >> 3] |= (0x01U << (j & 7));

    j++;
  }

  return checksum(out);
}

void CDStarRX::acs(int* metric)
{
  int tempMetric[4U];

  unsigned int j = m_mar >> 3;
  unsigned int k = m_mar & 7;

  // Pres. state = S0, Prev. state = S0 & S2
  int m1 = metric[0U] + m_pathMetric[0U];
  int m2 = metric[4U] + m_pathMetric[2U];
  tempMetric[0U] = m1 < m2 ? m1 : m2;
  if (m1 < m2)
    m_pathMemory0[j] &= BIT_MASK_TABLE0[k];
  else
    m_pathMemory0[j] |= BIT_MASK_TABLE1[k];

  // Pres. state = S1, Prev. state = S0 & S2
  m1 = metric[1U] + m_pathMetric[0U];
  m2 = metric[5U] + m_pathMetric[2U];
  tempMetric[1U] = m1 < m2 ? m1 : m2;
  if (m1 < m2)
    m_pathMemory1[j] &= BIT_MASK_TABLE0[k];
  else
    m_pathMemory1[j] |= BIT_MASK_TABLE1[k];

  // Pres. state = S2, Prev. state = S2 & S3
  m1 = metric[2U] + m_pathMetric[1U];
  m2 = metric[6U] + m_pathMetric[3U];
  tempMetric[2U] = m1 < m2 ? m1 : m2;
  if (m1 < m2)
    m_pathMemory2[j] &= BIT_MASK_TABLE0[k];
  else
    m_pathMemory2[j] |= BIT_MASK_TABLE1[k];

  // Pres. state = S3, Prev. state = S1 & S3
  m1 = metric[3U] + m_pathMetric[1U];
  m2 = metric[7U] + m_pathMetric[3U];
  tempMetric[3U] = m1 < m2 ? m1 : m2;
  if (m1 < m2)
    m_pathMemory3[j] &= BIT_MASK_TABLE0[k];
  else
    m_pathMemory3[j] |= BIT_MASK_TABLE1[k];

  for (unsigned int i = 0U; i < 4U; i++)
    m_pathMetric[i] = tempMetric[i];

  m_mar++;
}
 
void CDStarRX::viterbiDecode(int* data)
{
  int metric[8U];
  
  metric[0] = (data[1] ^ 0) + (data[0] ^ 0);
  metric[1] = (data[1] ^ 1) + (data[0] ^ 1);
  metric[2] = (data[1] ^ 1) + (data[0] ^ 0);
  metric[3] = (data[1] ^ 0) + (data[0] ^ 1);
  metric[4] = (data[1] ^ 1) + (data[0] ^ 1);
  metric[5] = (data[1] ^ 0) + (data[0] ^ 0);
  metric[6] = (data[1] ^ 0) + (data[0] ^ 1);
  metric[7] = (data[1] ^ 1) + (data[0] ^ 0);
  
  acs(metric);
}

void CDStarRX::traceBack()
{
  // Start from the S0, t=31
  unsigned int j = 0U;
  unsigned int k = 0U;
  for (int i = 329; i >= 0; i--) {
    switch (j) {
      case 0U: // if state = S0
        if (!READ_BIT1(m_pathMemory0, i))
          j = 0U;
        else
          j = 2U;
        WRITE_BIT1(m_fecOutput, k, false);
        k++;
        break;


      case 1U: // if state = S1
        if (!READ_BIT1(m_pathMemory1, i))
          j = 0U;
        else
          j = 2U;
        WRITE_BIT1(m_fecOutput, k, true);
        k++;
        break;

      case 2U: // if state = S1
        if (!READ_BIT1(m_pathMemory2, i))
          j = 1U;
        else
          j = 3U;
        WRITE_BIT1(m_fecOutput, k, false);
        k++;
        break;

      case 3U: // if state = S1
        if (!READ_BIT1(m_pathMemory3, i))
          j = 1U;
        else
          j = 3U;
        WRITE_BIT1(m_fecOutput, k, true);
        k++;
        break;
    }
  }
}

bool CDStarRX::checksum(const uint8_t* header) const
{
  union {
    uint16_t crc16;
    uint8_t  crc8[2U];
  };

  crc16 = 0xFFFFU;
  for (uint8_t i = 0U; i < (DSTAR_HEADER_LENGTH_BYTES - 2U); i++)
    crc16 = uint16_t(crc8[1U]) ^ CCITT_TABLE[crc8[0U] ^ header[i]];

  crc16 = ~crc16;

  return crc8[0U] == header[DSTAR_HEADER_LENGTH_BYTES - 2U] && crc8[1U] == header[DSTAR_HEADER_LENGTH_BYTES - 1U];
}

int CDStarRX::slowSpeedDataDecode(unsigned char a, unsigned char b, unsigned char c)
{
  static bool          bSyncFound;
  static bool          bFirstSection;
  static bool          bHeaderActive;
  static int           iSection;
  static unsigned char ucType;
  int                  iRet = 0;
  static char          cText[30];

  // Unscramble
  a ^= 0x70;
  b ^= 0x4f;
  c ^= 0x93;

  if (a == 0x25 && b == 0x62 && c == 0x85)
  {
    bSyncFound = true;
    bFirstSection = true;
    memset(cText, 0x20, 29);
  }

  if (bFirstSection)
  {
    ucType = (unsigned char)(a & 0xf0);

    // DV Header start
    if (bSyncFound == true && ucType == 0x50)
    {
      bSyncFound = false;
      bHeaderActive = true;
    }

    bFirstSection = false;

    switch (ucType)
    {
      case 0x50:  // Header
        break;

      case 0x30:  // GPS
        break;

      case 0x40:  // Text
        iSection = a & 0x0f;
        if (iSection >= 4)
        {
          bFirstSection = true;
          break;
        }
        cText[iSection * 5 + 0] = b;
        cText[iSection * 5 + 1] = c;
        break;

      case 0xc0:  // Code Squelch
        break;

      default:
        bFirstSection = true;
        break;

    }
  }
  else
  {
    switch (ucType)
    {
      case 0x50:  // Header
        break;

      case 0x30:  // GPS
        break;

      case 0x40:  // Text
        cText[iSection * 5 + 2] = a;
        cText[iSection * 5 + 3] = b;
        cText[iSection * 5 + 4] = c;
        if (iSection == 3)
        {
          if (memcmp(cText, m_text, 20) != 0)
          {
            m_slowSpeedUpdate = true;
            memcpy(m_text, cText, 20);
            m_text[20] = 0;
            m_slowSpeedUpdate = false;
          }
          iRet = 3;
          memset(cText, 0x20, 30);
        }

        break;

      case 0xc0:  // Code Squelch
        break;
    }
    bFirstSection = true;
  }
  return iRet;
}

void CDStarRX::getMyCall(char *myCall)
{
  strcpy(myCall, m_myCall);
}

void CDStarRX::getUrCall(char *urCall)
{
  strcpy(urCall, m_urCall);
}

void CDStarRX::getRpt1Call(char *rpt1Call)
{
  strcpy(rpt1Call, m_rpt1Call);
}

void CDStarRX::getRpt2Call(char *rpt2Call)
{
  strcpy(rpt2Call, m_rpt2Call);
}

void CDStarRX::getSuffix(char *suffix)
{
  strcpy(suffix, m_suffix);
}

void CDStarRX::getText(char *text)
{
  strcpy(text, m_text);
}

void CDStarRX::getData(uint8_t *data)
{
  for (int i=0;i<9;i++)
    data[i] = m_message[i];
}
