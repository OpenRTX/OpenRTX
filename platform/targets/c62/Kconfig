## platform/targets/c62/Kconfig.board
```kconfig
# SPDX-FileCopyrightText: Copyright 2020-2026 OpenRTX Contributors
#
# SPDX-License-Identifier: GPL-3.0-or-later

config BOARD_C62
	bool "Retevis C62"
	depends on SOC_CSK6
```

## west.yml
```yaml
# SPDX-License-Identifier: GPL-3.0-or-later
# SPDX-FileCopyrightText: Copyright 2020-2026 OpenRTX Contributors
#
# This file is part of OpenRTX.

manifest:
  self:
    path: OpenRTX

  defaults:
    remote: zephyr

  group-filter:
    - -csk6
    - -esp32

  remotes:
    - name: openrtx
      url-base: https://github.com/OpenRTX

    - name: zephyr
      url-base: https://github.com/zephyrproject-rtos

  projects:
    # Zephyr mainline modules
    - name: zephyr
      remote: zephyr
      revision: a4de2eb3d1756c445d2e2ecb72e6d562674c118b
      path: zephyr
      west-commands: scripts/west-commands.yml
      groups:
        - esp32

    - name: mcuboot
      remote: zephyr
      revision: 9bf7ce8c5fe8152836a6e00bd4444153bd950342
      path: bootloader/mcuboot
      groups:
        - esp32

    - name: hal_espressif
      remote: zephyr
      revision: 80d910ca89eab9bce03f59a4ade33f1fc30ce0ad
      path: modules/hal/espressif
      west-commands: west/west-commands.yml
      groups:
        - esp32

    - name: cmsis
      remote: zephyr
      repo-path: cmsis
      revision: 74981bf893e8b10931464b9945e2143d99a3f0a3
      path: modules/hal/cmsis
      groups:
        - csk6

    # ListenAI fork-specific modules. The four libraries are pinned to commits
    # of their openrtx-c62 branches: they must match the DSP firmware.
    - name: listenai-zephyr
      remote: openrtx
      repo-path: listenai-zephyr
      revision: b8fcc47cc045871d5127a78a77b3f30feb65e8cd
      path: zephyr-listenai
      west-commands: scripts/west-commands.yml
      groups:
        - csk6

    - name: listenai-csk
      remote: openrtx
      repo-path: listenai-csk
      revision: f097b7f9dfe4aba9fae08af787230e023ee21aa0
      path: csk
      groups:
        - csk6

    - name: listenai-hal
      remote: openrtx
      repo-path: csk6_cm33
      revision: 9444f3dc2abec4d49e5daa6112a798ee43999222
      path: modules/hal/listenai/csk6_cm33
      groups:
        - csk6

    - name: listenai-modules-af
      remote: openrtx
      revision: c94c49ffb883b6d15b284b84d0eb13394ac07422
      path: modules/lib/af
      groups:
        - csk6

    - name: listenai-modules-freertos_shims
      remote: openrtx
      revision: 62e3c7e459c6ad859b2c86a8733ad8dab058806a
      path: modules/lib/freertos_shims
      groups:
        - csk6

    - name: listenai-modules-lsf
      remote: openrtx
      revision: 1aafb369f7ac5a25f4ea08e004713380eec7c50d
      path: modules/lib/lsf
      groups:
        - csk6

    - name: listenai-modules-urpc
      remote: openrtx
      revision: 0e450f3ba1cad8f6b677f917f7f158d3122ddbe3
      path: modules/lib/urpc
      groups:
        - csk6
```
