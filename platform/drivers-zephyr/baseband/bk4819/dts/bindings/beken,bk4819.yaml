## platform/drivers-zephyr/baseband/bk4819/dts/bindings/beken,bk4819.yaml
```yaml
# SPDX-FileCopyrightText: Copyright 2020-2026 OpenRTX Contributors
#
# SPDX-License-Identifier: GPL-3.0-or-later

description: Beken BK4819 Radio Transceiver

compatible: "beken,bk4819"

include: [base.yaml]

properties:
  sclk-gpios:
    type: phandle-array
    required: true
    description: GPIO pin for SPI clock

  sdata-gpios:
    type: phandle-array
    required: true
    description: GPIO pin for SPI data

  scn-gpios:
    type: phandle-array
    required: true
    description: GPIO pin for chip select
```

## platform/targets/c62/dts/bindings/display/retevis,c62-st7735r.yaml
```yaml
# SPDX-FileCopyrightText: Copyright 2020-2026 OpenRTX Contributors
#
# SPDX-License-Identifier: GPL-3.0-or-later

description: |
  ST7735R display as wired on the Retevis C62, with the RESET pin not
  connected to the MCU.

  The stock binding requires reset-gpios, while the driver falls back to a
  software reset when it is missing. List this compatible before
  "sitronix,st7735r" so the driver still binds to the node.

compatible: "retevis,c62-st7735r"

include:
  - name: sitronix,st7735r.yaml
    property-blocklist:
      - reset-gpios

properties:
  reset-gpios:
    type: phandle-array
    required: false
    description: RESET pin, active low. Not connected on the C62.
```

## platform/targets/c62/services/Kconfig
```kconfig
# Copyright (c) 2023 LISTENAI
# SPDX-License-Identifier: Apache-2.0

menu "LSF Services"

DT_COMPAT_LSF_AUDIO_SERVICE := lsf,audio-service

config LSF_AUDIO_SERVICE
	bool "LSF Audio Service"
	default $(dt_compat_enabled,$(DT_COMPAT_LSF_AUDIO_SERVICE))

endmenu
```

## west.yml
```yaml
# SPDX-License-Identifier: GPL-3.0-or-later
# SPDX-FileCopyrightText: Copyright 2020-2026 OpenRTX Contributors
#
# This file is part of OpenRTX.

manifest:
  self:
    path: OpenRTX

  defaults:
    remote: zephyr

  group-filter:
    - -csk6

  remotes:
    - name: openrtx
      url-base: https://github.com/OpenRTX

    - name: zephyr
      url-base: https://github.com/zephyrproject-rtos

  projects:
    # Zephyr mainline modules
    - name: zephyr
      remote: zephyr
      revision: a4de2eb3d1756c445d2e2ecb72e6d562674c118b
      path: zephyr
      west-commands: scripts/west-commands.yml

    - name: mcuboot
      remote: zephyr
      revision: 9bf7ce8c5fe8152836a6e00bd4444153bd950342
      path: bootloader/mcuboot

    - name: hal_espressif
      remote: zephyr
      revision: 80d910ca89eab9bce03f59a4ade33f1fc30ce0ad
      path: modules/hal/espressif
      west-commands: west/west-commands.yml

    - name: cmsis
      remote: zephyr
      repo-path: cmsis
      revision: 74981bf893e8b10931464b9945e2143d99a3f0a3
      path: modules/hal/cmsis
      groups:
        - csk6

    # ListenAI fork-specific modules
    - name: listenai-zephyr
      remote: openrtx
      repo-path: listenai-zephyr
      revision: b8fcc47cc045871d5127a78a77b3f30feb65e8cd
      path: zephyr-listenai
      west-commands: scripts/west-commands.yml
      groups:
        - csk6

    - name: listenai-csk
      remote: openrtx
      repo-path: listenai-csk
      revision: f097b7f9dfe4aba9fae08af787230e023ee21aa0
      path: csk
      groups:
        - csk6

    - name: listenai-hal
      remote: openrtx
      repo-path: csk6_cm33
      revision: 9444f3dc2abec4d49e5daa6112a798ee43999222
      path: modules/hal/listenai/csk6_cm33
      groups:
        - csk6

    - name: listenai-modules-af
      remote: openrtx
      revision: openrtx-c62
      path: modules/lib/af
      groups:
        - csk6

    - name: listenai-modules-freertos_shims
      remote: openrtx
      revision: openrtx-c62
      path: modules/lib/freertos_shims
      groups:
        - csk6

    - name: listenai-modules-lsf
      remote: openrtx
      revision: openrtx-c62
      path: modules/lib/lsf
      groups:
        - csk6

    - name: listenai-modules-urpc
      remote: openrtx
      revision: openrtx-c62
      path: modules/lib/urpc
      groups:
        - csk6
```
