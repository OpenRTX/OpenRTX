## lib/zephyr/boards/xtensa/ttwrplus/Kconfig.board
```kconfig
# LilyGo T-TWR Plus board configuration

# SPDX-License-Identifier: Apache-2.0

config BOARD_TTWRPLUS
	bool "LilyGo T-TWR Plus Board"
	depends on SOC_ESP32S3
```

## platform/drivers-zephyr/baseband/bk1080/Kconfig
```kconfig
config BK1080
    bool "BK1080 Radio"
    default y
    depends on GPIO
    help
      Enable driver for BK1080 radio transceiver.

if BK1080

# Automatic Log level configuration
module = BK1080
module-str = bk1080
source "subsys/logging/Kconfig.template.log_config"

config BK1080_INIT_PRIORITY
    int "BK1080 initialization priority"
    default 90
    help
      System initialization priority for BK1080 driver.

endif # BK1080
```

## platform/drivers-zephyr/baseband/bk1080/dts/bindings/beken,bk1080.yaml
```yaml
description: Beken BK1080 Radio

compatible: "beken,bk1080"

include: [base.yaml]

properties:
  i2c-clk-gpios:
    type: phandle-array
    required: true
    description: pin for I2C clock

  i2c-data-gpios:
    type: phandle-array
    required: true
    description: pin for I2C data

  power-gpios:
    type: phandle-array
    required: true
    description: GPIO pin to switch BK1080 power on
```

## platform/drivers-zephyr/baseband/bk4819/Kconfig
```kconfig
config BK4819
    bool "BK4819 Radio Transceiver"
    default y
    depends on GPIO
    help
      Enable driver for BK4819 radio transceiver.

if BK4819

# Automatic Log level configuration
module = BK4819
module-str = bk4819
source "subsys/logging/Kconfig.template.log_config"

config BK4819_INIT_PRIORITY
    int "BK4819 initialization priority"
    default 90
    help
      System initialization priority for BK4819 driver.

endif # BK4819
```

## platform/targets/c62/Kconfig.board
```kconfig
# SPDX-License-Identifier: Apache-2.0

config BOARD_C62
   bool "Retevis C62"
   depends on SOC_CSK6

menu "DSP Manipulation"

config LSF_DSP
	bool "DSP Manipulation"
	default y
	select FLASH
	select FLASH_MAP

if LSF_DSP

config LSF_DSP_INIT_PRIORITY
	int "Init priority"
	default 80

DT_CHOSEN_LSF_DSP_FIRMWARE := lsf,dsp-firmware

config LSF_DSP_LOAD_ON_BOOT
	bool "Load DSP firmware on boot"
	default y
	depends on $(dt_chosen_enabled,$(DT_CHOSEN_LSF_DSP_FIRMWARE))

endif # LSF_DSP

endmenu

DT_COMPAT_LSF_SERVICE_CONTROLLER := lsf,service-controller

config LSF_SERVICE_CONTROLLER
	bool "LSF Service Controller"
	select REQUIRES_FULL_LIBC

if LSF_SERVICE_CONTROLLER
rsource "services/Kconfig"
endif # LSF_SERVICE_CONTROLLER
```

## platform/targets/c62/Kconfig.defconfig
```kconfig
if BOARD_C62

config BOARD
   default "c62"

DT_CHOSEN_Z_PSRAM := zephyr,psram

config PSRAM_SIZE
	hex
	default "$(dt_chosen_reg_size_hex,$(DT_CHOSEN_Z_PSRAM))"

endif # BOARD_C62
```

## platform/targets/c62/modules/lib/freertos_shims/Kconfig
```kconfig
config FREERTOS_SHIMS
	bool "Enable freertos shims"
	default y
	help
		Enable freertos shims

config VENUS_CLOG_LEVEL
	int "CLOG Level"
	default 2
```

## platform/targets/c62/modules/lib/lsf/Kconfig
```kconfig
config LSF
    bool "enable lsf"
    default y
    help
       lsf use or not
choice

prompt "lsf type"

config LSF_CLIENT
    bool "lsf client"

config LSF_SERVER
    bool "lsf server"

endchoice

config LSF_IC_MESSAGE
    bool "lsf message"
    default y
    help
        lsf message

config LSF_CONNECT_TIME_SLEEP
    int "lsf connect time sleep microseconds"
    default 1
    depends on LSF
    help
        lsf connect time sleep microseconds

rsource "./targets/Kconfig"
rsource "./ic_message/Kconfig"
```

## platform/targets/c62/modules/lib/lsf/ic_message/Kconfig
```kconfig
config LSF_IC_MESSAGE_DEPRECATED
    bool "lsf ic message api deprecated"
    default n
    help
      lsf ic message api deprecated

config LSF_IC_MESSAGE_EP_ID
    int "lsf ic message endpoint id"
    default 0
    range 0 15
    help
       lsf ic message endpoint id
```

## platform/targets/c62/modules/lib/lsf/targets/Kconfig
```kconfig
config LSF_OS
    bool "os supported"
    default y
    help
      os supported

if LSF_OS

choice
prompt "os type"

config LSF_OS_ZEPHYR
    bool "os supported for zephyr"

config LSF_OS_FRERRTOS
    bool "os supported for freertos"

config LSF_OS_XOS
    bool "os supported for xos"

endchoice

endif
```

## platform/targets/ttwr21/Kconfig
```kconfig
# LilyGo T-TWR Plus board configuration

# SPDX-License-Identifier: Apache-2.0

config HEAP_MEM_POOL_ADD_SIZE_BOARD
	int
	default 4096 if BOARD_TTWR21_ESP32S3_PROCPU
	default 256 if BOARD_TTWR21_ESP32S3_APPCPU
```

## platform/targets/ttwr21/Kconfig.board
```kconfig
# LILYGO T-TWR REV2.1 board configuration

# SPDX-License-Identifier: Apache-2.0

config BOARD_TTWR21
	bool "LILYGO T-TWR REV2.1 Board"
	depends on SOC_SERIES_ESP32S3

choice SOC_PART_NUMBER
	default SOC_ESP32S3_WROOM_N16R8
endchoice
```

## platform/targets/ttwr21/Kconfig.defconfig
```kconfig
# LilyGo T-TWR Plus board configuration

# SPDX-License-Identifier: Apache-2.0

config BOARD
	default "ttwr21"
	depends on BOARD_TTWR21

config ENTROPY_GENERATOR
	default y

config HEAP_MEM_POOL_SIZE
	default 98304 if WIFI
	default 40960 if BT
	default 4096

choice BT_HCI_BUS_TYPE
	default BT_ESP32 if BT
endchoice
```

## platform/targets/ttwr21/Kconfig.ttwr21
```kconfig
# LILYGO T-TWR REV2.1 board configuration
# SPDX-License-Identifier: Apache-2.0

config BOARD_TTWR21
	select SOC_ESP32S3_WROOM_N16R8
	select SOC_ESP32S3_PROCPU if BOARD_TTWR21_ESP32S3_PROCPU
	select SOC_ESP32S3_APPCPU if BOARD_TTWR21_ESP32S3_APPCPU
```

## platform/targets/ttwr21/board.yml
```yaml
board:
  name: ttwr21
  full_name: T-TWR REV2.1
  vendor: lilygo
  socs:
  - name: esp32s3
```

## platform/targets/ttwrplus/Kconfig.board
```kconfig
# SPDX-FileCopyrightText: Copyright 2020-2026 OpenRTX Contributors
#
# SPDX-License-Identifier: GPL-3.0-or-later
#
# LilyGo T-TWR Plus board configuration

config BOARD_TTWRPLUS
	bool "LilyGo T-TWR Plus Board"
	depends on SOC_SERIES_ESP32S3

choice SOC_PART_NUMBER
	default SOC_ESP32S3_WROOM_N16R8
endchoice
```

## platform/targets/ttwrplus/Kconfig.defconfig
```kconfig
# SPDX-FileCopyrightText: Copyright 2020-2026 OpenRTX Contributors
#
# SPDX-License-Identifier: GPL-3.0-or-later
#
# LilyGo T-TWR Plus board configuration

config BOARD
	default "ttwrplus"
	depends on BOARD_TTWRPLUS

config ENTROPY_GENERATOR
	default y

config HEAP_MEM_POOL_SIZE
	default 98304 if WIFI
	default 40960 if BT
	default 4096

choice BT_HCI_BUS_TYPE
	default BT_ESP32 if BT
endchoice
```

## platform/targets/ttwrplus/Kconfig.sysbuild
```kconfig
# SPDX-FileCopyrightText: Copyright 2020-2026 OpenRTX Contributors
#
# SPDX-License-Identifier: GPL-3.0-or-later

choice BOOTLOADER
	default BOOTLOADER_MCUBOOT
endchoice

choice BOOT_SIGNATURE_TYPE
	default BOOT_SIGNATURE_TYPE_NONE
endchoice
```

## platform/targets/ttwrplus/ttwrplus_defconfig
```kconfig
# SPDX-FileCopyrightText: Copyright 2020-2026 OpenRTX Contributors
#
# SPDX-License-Identifier: GPL-3.0-or-later
CONFIG_SOC_SERIES_ESP32S3=y
CONFIG_DISPLAY=y
CONFIG_SSD1306=y
CONFIG_THREAD_STACK_INFO=y
CONFIG_DYNAMIC_THREAD=y
CONFIG_DYNAMIC_THREAD_STACK_SIZE=4096
CONFIG_DYNAMIC_THREAD_PREFER_POOL=y
CONFIG_DYNAMIC_THREAD_POOL_SIZE=4
CONFIG_COMMON_LIBC_MALLOC=y
CONFIG_COMMON_LIBC_MALLOC_ARENA_SIZE=131072
CONFIG_INPUT=y
CONFIG_INPUT_GPIO_KEYS=y
CONFIG_SENSOR=y
CONFIG_SERIAL=y
CONFIG_UART_INTERRUPT_DRIVEN=y
CONFIG_UART_USE_RUNTIME_CONFIGURE=y
CONFIG_ASSERT=y
CONFIG_SPI=y
CONFIG_LED_STRIP=y
CONFIG_WS2812_STRIP=y
CONFIG_WS2812_STRIP_SPI=y
CONFIG_POSIX_API=y
CONFIG_FLASH=y
CONFIG_FLASH_MAP=y
CONFIG_SOC_FLASH_ESP32=y
```
